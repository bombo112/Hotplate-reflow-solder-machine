
#include <U8g2lib.h>
#include <cmath>

#ifdef U8X8_HAVE_HW_SPI
#include <SPI.h>
#endif



const unsigned char batman[] PROGMEM = {
  B10101010,B00101010,B10101111,B11111111,B11111111,B11111111,B11111111,B11111111,B11111111,B11111111,B11111111,B11110101,B01010100,B00101010,B11111111,
  B01010101,B00010101,B01011111,B11111111,B11111111,B11111111,B11111111,B11111111,B11111111,B11111111,B11111111,B11111010,B11000010,B01010101,B01111111,
  B10101010,B10000001,B01111111,B11111111,B11111101,B11110111,B11111111,B11111111,B11010111,B10111111,B11111111,B11111101,B00101000,B10101010,B11111111,
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  B10101010,B10111111,B11111111,B11111110,B11111111,B11010111,B01010100,B00000000,B01111111,B11111111,B11111111,B11111111,B11111010,B10101010,B11111111
};



const unsigned char start_icon[] PROGMEM = {
  B00000000,B00000000,B00000000,B00000000,B00000000,
  B00000000,B00000000,B00000000,B00000000,B00000000,
  B00000000,B00000000,B00000000,B00000000,B00000000,
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  B00000000,B00000000,B00000000,B00000000,B00000000
};



const unsigned char settings_icon[] PROGMEM = {
  B00000000,B00000000,B01111110,B00000000,B00000000,
  B00000000,B00000000,B11111111,B00000000,B00000000,
  B00000000,B00000001,B11111111,B10000000,B00000000,
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  B00000000,B00000000,B01111110,B00000000,B00000000
};


const unsigned char set_temp_mode[] PROGMEM = {
  B00000000,B00001110,B00000000,B00000000,B00000000,
  B00000000,B00111111,B10000000,B00000000,B00000000,
  B00000000,B01110001,B11000000,B00000000,B00000000,
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  B00000000,B00011111,B00000000,B00000000,B00000000
};


const unsigned char doom_icon[] PROGMEM = {
  B01111111,B11110000,B11111111,B00001111,B11111011,B11110011,B11110000,
  B00111111,B11111001,B11111111,B10011111,B11111111,B11111111,B11110000,
  B00111111,B11111111,B11111111,B11111111,B11111111,B11111111,B11110000,
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  B00000000,B00000000,B00000000,B00000000,B00000000,B00000000,B00000000
};




U8G2_SH1106_128X64_NONAME_F_4W_HW_SPI u8g2(U8G2_R0, /* cs=*/ 17, /* dc=*/ 20, /* reset=*/ 21);

const uint button_a_port = 10;
const uint button_b_port = 9;
const uint encoder_clock_port = 13;
const uint encoder_data_port = 14;
const uint encoder_switch_port = 15;
const uint relay_port = 12;
const uint buzzer_port = 11;
const uint termistor_port = A0; //26

const uint screen_width = 128;
const uint screen_height = 64;

bool button_a, button_b, encoder_left, encoder_right, encoder_switch;
int encoder_count;
bool encoder_current_state, encoder_last_state;
bool encoder_direction;

uint current_time, last_time, time_step = 100;

struct reflowprofile {
  uint ramp_speed;
  uint ramp_temp;
  uint soak_temp;
  uint soak_time;
  uint peak_temp;
  uint peak_time;
};

struct reflowprofile profile1[] = {5, 150, 180, 60, 240, 40};
struct reflowprofile profile2[] = {5, 150, 180, 60, 240, 40};  
struct reflowprofile profile3[] = {5, 150, 180, 60, 240, 40};  
struct reflowprofile profile4 {5, 150, 180, 60, 240, 40};  




void setup() {
  u8g2.begin();
  u8g2.drawBitmap(0, 0, 15, 64, batman);
  u8g2.sendBuffer();
  delay(1000);
  pinMode(button_a_port, INPUT);
  pinMode(button_b_port, INPUT);

  pinMode(encoder_clock_port, INPUT);
  pinMode(encoder_data_port, INPUT);
  pinMode(encoder_switch_port, INPUT);

  //attachInterrupt(digitalPinToInterrupt(encoder_clock_port), encoder_update, CHANGE);

  pinMode(relay_port, OUTPUT);
  pinMode(buzzer_port, OUTPUT);

  pinMode(termistor_port, INPUT);

  Serial.begin(9600);
}


void main_menu(){
  u8g2.setFont(u8g2_font_tinyunicode_tr);
  //main menu variables
  char *menu_items[] = {"Reflow", "Setup", "Settings", "DOOM"}; //box names
  const unsigned char *menu_icons[] = {start_icon, set_temp_mode, settings_icon, doom_icon};
  const uint menu_itmes_count = 4;   //count of all boxes
  const uint menu_screen_items = 3;  //how many boxes on screen
  uint menu_scroll = 0;       //scroll point, points to first box on screen
  uint menu_select = 0;       //selected box of all boxes
  uint menu_focus = 0;        //selected box on screen
  const uint menu_box_diff = 1;
  while (true) {
    read_buttons();
    read_temperature();

    encoder_count = constrain(encoder_count, 0, menu_itmes_count-1);
    menu_select = encoder_count;

    if (menu_select < menu_scroll) {                                            //if selected box is above the higest displayed box then scroll upward
      menu_scroll --;}
    if (menu_select > menu_scroll + menu_screen_items-1) {                     //if selected box is below the lowest displayed box then scroll downward
      menu_scroll ++;}

    menu_focus = menu_select - menu_scroll;

    current_time = millis();
    if (millis() > last_time + time_step){
      last_time = current_time;
      u8g2.clearBuffer();
      for (int i=0; i<menu_screen_items; i++){
        u8g2.drawFrame(i*(screen_width+1)/menu_screen_items + menu_box_diff, menu_box_diff, screen_width/menu_screen_items-1 - (menu_box_diff * 2), screen_height-(menu_box_diff * 2)-1);
        u8g2.setCursor(i*(screen_width+1)/menu_screen_items + 5, 15);
        u8g2.print(menu_items[menu_scroll+i]);
        u8g2.drawBitmap(i*(screen_width+1)/menu_screen_items + 5, 20, 5, 40, menu_icons[menu_scroll+i]);
      }      
      u8g2.drawFrame(menu_focus*(screen_width+1)/menu_screen_items, 0, screen_width/menu_screen_items-1, screen_height-1);

      u8g2.sendBuffer();
    }
  }
}


int read_temperature(){
  const int samples = 20;
  float sum, averageC;
  for (int i; i<samples; i++){
    float raw_reading = analogRead(termistor_port);
    const float R1 = 4700;
    const float vref = 3.13;

    const float Ac = 0.7394739885e-3;
    const float Bc = 2.126157432e-4;
    const float Cc = 1.087351854e-7;
    const float Beta = 3041.01;

    float voltage_reading = raw_reading * vref /(1023.0);
    float R2 = -(vref * R1)/(voltage_reading - vref);
    
    //float kelvin = 1 / (Beta * log(R2) + 1/ 298.15);
    float kelvin = 1.0 / (Ac + (Bc*log(R2)) + (Cc*log(R2)*log(R2)*log(R2)));
    float celsius = kelvin - 273.15;
    
    sum = sum + celsius;
  }
  averageC = sum / samples;

  /*
  Serial.print(raw_reading);
  Serial.print("   ");
  Serial.print(voltage_reading);
  Serial.print("V");
  Serial.print("   ");
  Serial.print(R2/1000);
  Serial.print("k");
  Serial.print("   ");
  */
  Serial.print(averageC);
  Serial.println("*C");
  return averageC;
}


void reflow(){
  uint reflow_start_time, reflow_time;





  while (1){



  current_time = millis();
    if (millis() > last_time + time_step){
      last_time = current_time;
      u8g2.clearBuffer();


      u8g2.sendBuffer();
    }
  }
}




void read_buttons(){
  if (digitalRead(button_a_port)       == LOW) {button_a = true;}       else {button_a = false;}
  if (digitalRead(button_b_port)       == LOW) {button_b = true;}       else {button_b = false;}
  if (digitalRead(encoder_switch_port) == LOW) {encoder_switch = true;} else {encoder_switch = false;}
  encoder_update();
}


void encoder_update(){
  encoder_current_state = digitalRead(encoder_clock_port);
  if (encoder_current_state != encoder_last_state && encoder_current_state == 1){
    if (digitalRead(encoder_data_port) == 1) {
      encoder_count --;
      encoder_direction = false;
    }
    if (digitalRead(encoder_data_port) == 0){
      encoder_count ++;
      encoder_direction = true;
    }
    
  }
  encoder_last_state = encoder_current_state;
}


void loop() {
  read_buttons();
  current_time = millis();
  if (current_time > last_time + time_step){
    last_time = current_time;


    main_menu();    
    Serial.print(button_a);
    Serial.print(" ");
    Serial.print(button_b);
    Serial.print(" ");
    Serial.print(encoder_switch);
    Serial.print(" ");
    Serial.print(encoder_count);
    Serial.println("");
  }
}
















